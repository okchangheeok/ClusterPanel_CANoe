VERSION ""

NS_ :

BS_:

BU_:

BO_ 256 MyCluster: 3 Vector__XXX
 SG_ RPM : 8|16@1+ (1,0) [0|8000] "RPM" Vector__XXX
 SG_ Accel : 0|8@1+ (1,0) [0|100] "%" Vector__XXX

BA_DEF_  "BusType" STRING ;
BA_DEF_DEF_  "BusType" "CAN";
